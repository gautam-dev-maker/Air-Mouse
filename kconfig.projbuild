## kconfig.projbuild
```kconfig
menu "Air-Mouse Bluetooth Configuration"
    config BluetoothName
        string "BluetoothName"
        default "Gaut_Am"
    config SDA_pin
        int "SDA PIN"
        default 21    
endmenu
```

## main/kconfig.projbuild
```kconfig
menu "Air-Mouse Bluetooth Configuration"
    config BluetoothName
        string "BluetoothName"
        default "Gaut_Am"
    config SDAPin
        int "SDA Pin"
        default 21
    config CLKPin
        int "CLK Pin"
        default 22    
endmenu
```
